/**
 ******************************************************************************
 * @file           : main.c
 * @author         : Auto-generated by STM32CubeIDE
 * @brief          : Main program body
 ******************************************************************************
 * En este proyecto por una parte utilizo un potenciometro conectado a A2 / PA4
  * mediante ADC1_IN4, aplica un filtro de promedio móvil para estabilizar la
  * medición y usa el valor filtrado para modificar el duty cycle de una señal
  * PWM de 1 kHz generada con TIM2_CH1 sobre PA5 / D13.
  * La señal PWM se aplica al pin ENA del driver L298N para controlar la velocidad
  * de un motor DC, mientras que dos salidas digitales del STM32, PB5 / D4 y PB10 / D6,
  * controlan el sentido de giro mediante las entradas IN1 e IN2 del driver.
  * Además, el proyecto envía por USART2 el valor ADC filtrado, la tensión estimada,
  * el valor de CCR1, el duty cycle y el sentido de giro configurado.
  * Despues mido distancia con un sensor ultrasónico HC-SR04 utilizando
  * TIM1 en modo Input Capture con interrupción. El pin TRIG se controla desde D8 / PA9,
  * mientras que la señal ECHO se mide en D7 / PA8 / TIM1_CH1.
  * El temporizador captura el instante del flanco de subida y luego el del flanco de bajada
  * de la señal ECHO. A partir de esa diferencia se calcula el ancho del pulso en microsegundos
  * y luego la distancia en centímetros.
  * El proyecto envía por USART2 el tiempo medido del pulso ECHO y la distancia calculada.
  * El objetivo didáctico es integrar GPIO, TIM Input Capture, interrupciones, medición temporal
  * por hardware y comunicación serie, mostrando cómo medir eventos externos con mayor precisión
  * que mediante polling.
  *

 *
 ******************************************************************************
 */

#include <stdint.h>
#include "main.h"
#include <stdio.h>
#include <string.h>

/*control sensor*/
/* Empiezo definiendo el trigger y el input capture del ultrasonido
 * Tiene cuatro pines:
	Trigger, echo vcc y gnd
	Trigger: 10ms Puerto A pin D8
	Hace una medicion cada 1000U para dejar tiempo a que desaparezcan echos anteriores
	El max count es porque esta configurado con un timeout de 16bits
 * */
#define HCSR04_TRIG_PORT       GPIOA
#define HCSR04_TRIG_PIN        GPIO_PIN_9   /* D8 / PA9 */
#define HCSR04_TIMEOUT_MS      60U
#define HCSR04_MEASUREMENT_PERIOD_MS  1000U
#define TIM1_MAX_COUNT         65535UL

void SystemClock_Config(void);
static void MX_GPIO_Init(void);
static void MX_USART2_UART_Init(void);
static void MX_TIM1_Init(void);
TIM_HandleTypeDef htim1;

UART_HandleTypeDef huart2;



/* Defino los flanco de subida y de bajada
Capture state indica en que estado estamos (si es subida o bajada)
Rising edge guarda el valor del contador en flaco de subida
Falling edge rango de bajada
Pulse guarda las veces que se suma el contador por 1ms
Usa static volatile para avisar al compilador que la variable puede cambiar fuera del flujo del programa, y que necesita ir directo a la memoria para usar ese dato.
*/
static volatile uint8_t  hcsr04_capture_state = 0U;
static volatile uint8_t  hcsr04_measurement_done = 0U;

static volatile uint32_t hcsr04_rising_edge = 0U;
static volatile uint32_t hcsr04_falling_edge = 0U;
static volatile uint32_t hcsr04_pulse_us = 0U;

/* defino el trigger y los nombres de las funciones que voy a utilizar para el ultrasonido */

static void HCSR04_DelayUs(uint32_t us);
static void HCSR04_Trigger(void);
static uint8_t HCSR04_ReadDistance_IC(uint32_t *pulse_us, uint32_t *distance_x10_cm);
static void USART2_SendDistance(uint8_t valid, uint32_t pulse_us, uint32_t distance_x10_cm);




/* -------------------------------------------------------------
 * Ahora las funciones del ultrasonido:
 *
 *HCSR04_DelayUs hace una demora en microsegundos
Hace una espera activa, que es indispensable porque el sensor
necesita un disparo originado por el microcontrolador en alto.
El while es la espera activa, que espera que la diferencia entre
el contador y el valor inicial sea igual al tiempo pedido
 *
 * ------------------------------------------------------------- */
static void HCSR04_DelayUs(uint32_t us)
{
    uint32_t start_count;

    /*
     * TIM1 está configurado con:
     *
     * f_TIM1 = 84 MHz
     * PSC = 83
     *
     * Por lo tanto:
     * f_CNT = 1 MHz
     * 1 cuenta = 1 us
     */
    start_count = __HAL_TIM_GET_COUNTER(&htim1);

    while ((__HAL_TIM_GET_COUNTER(&htim1) - start_count) < us)
    {
        /* Espera activa */
    }
}
/*HCSR04_Trigger(void); activa el trigger
Primero reinicia todas las variables para que no se pisen con mediciones anteriores.

1- Prepara para capturar el flanco de subida

2- Reinicia el contador desde cero, asi es mas facil obtener la referencia

3- Es importante limpiar los flag para no activar una interrupcion no necesaria

4- Genera el pulso del trigg, con la primer linea pone el cero el pin por 2ms,
Despues cambia la señal a 1 logico por 10ms
por ultimo lo deja nuevamente en cero.


     */

static void HCSR04_Trigger(void)
{
    /*
     * Reiniciar variables de medición.
     */
    hcsr04_capture_state = 0U;
    hcsr04_measurement_done = 0U;
    hcsr04_rising_edge = 0U;
    hcsr04_falling_edge = 0U;
    hcsr04_pulse_us = 0U;

    /*
     * Preparar TIM1_CH1 para capturar primero el flanco de subida.
     */
    __HAL_TIM_SET_CAPTUREPOLARITY(&htim1,
                                  TIM_CHANNEL_1,
                                  TIM_INPUTCHANNELPOLARITY_RISING);

    /*
     * Reiniciar contador antes de disparar el sensor.
     */
    __HAL_TIM_SET_COUNTER(&htim1, 0U);

    /*
     * Limpiar posible flag pendiente de captura.
     */
    __HAL_TIM_CLEAR_FLAG(&htim1, TIM_FLAG_CC1);

    /*
     * Generar pulso TRIG.
     *
     * El HC-SR04 requiere un pulso alto de al menos 10 us.
     */
    HAL_GPIO_WritePin(HCSR04_TRIG_PORT, HCSR04_TRIG_PIN, GPIO_PIN_RESET);
    HCSR04_DelayUs(2U);

    HAL_GPIO_WritePin(HCSR04_TRIG_PORT, HCSR04_TRIG_PIN, GPIO_PIN_SET);
    HCSR04_DelayUs(10U);

    HAL_GPIO_WritePin(HCSR04_TRIG_PORT, HCSR04_TRIG_PIN, GPIO_PIN_RESET);
}

/*Le da dos punteros, uno devuelve el ancho de pulso en ms
 * y el otro devuelve la distancia calculada, en el if
 * verifica si alguno de los dos es null para devolver un error.
 * En la siguiente linea lanza el trigger.
 * en la segunda linea hace una captura del tiempo que paso desde que inicio el programa

    */
static uint8_t HCSR04_ReadDistance_IC(uint32_t *pulse_us, uint32_t *distance_x10_cm)
{
    uint32_t start_tick;

    if ((pulse_us == NULL) || (distance_x10_cm == NULL))
    {
        return 0U;
    }

    /*
     * Disparar medición.
     */
    HCSR04_Trigger();

    start_tick = HAL_GetTick();

    /*
     * Esperar hasta que el Input Capture detecte:
     *
     * 1. Flanco de subida de ECHO.
     * 2. Flanco de bajada de ECHO.
     *
     * La medición termina cuando el callback coloca
     * hcsr04_measurement_done = 1.
     */
    while (hcsr04_measurement_done == 0U)
    {
        if ((HAL_GetTick() - start_tick) > HCSR04_TIMEOUT_MS)
        {
            /*
             * Si se cumple el plazo de esta funcion vuelve a cero
             * porque algo funciono mal, si se encuentra con un 1 se
             * ejecuta la proxima instrucciòn.
             * Modifica el ancho de pulso en
             * la memoria, despues toma ese pulso y calcula la distancia.

             */
            hcsr04_capture_state = 0U;

            __HAL_TIM_SET_CAPTUREPOLARITY(&htim1,
                                          TIM_CHANNEL_1,
                                          TIM_INPUTCHANNELPOLARITY_RISING);

            return 0U;
        }
    }

    *pulse_us = hcsr04_pulse_us;

    /*
     * Cálculo de distancia.
     *
     * Velocidad del sonido aproximada:
     * v = 343 m/s = 0,0343 cm/us
     *
     * El pulso ECHO representa ida y vuelta.
     *
     * distancia_cm = pulse_us * 0,0343 / 2
     * distancia_cm = pulse_us * 0,01715
     *
     * Para evitar float:
     *
     * distancia_x10_cm = distancia_cm * 10
     * distancia_x10_cm = pulse_us * 0,1715
     * distancia_x10_cm = pulse_us * 1715 / 10000
     *
     * Se suma 5000 para redondear.
     */
    *distance_x10_cm = (((*pulse_us) * 1715UL) + 5000UL) / 10000UL;

    return 1U;
}

/*
             *El HAL_TIM_IC_CaptureCallback no la llamamos nosotros, se aplica directamente cuando
             *configuramos la hal
   * Una vez que se almacena el valor del ccr1, ese valor se lleva al NVIC, que es el controlador
   * de las interrupciones si la interrupciòn esta habilitada, la cpu entra al HANDLER,
   * aca es diferente que hacerlo en codigo sin conceptualizar
   * , porque dentro de ese handler la hal hace la siguiente Funcion.
   * Cuando nosotros implementamos manualmente una interrupcion no usamos un callback, usamos
   * directamete el handler
             */
void HAL_TIM_IC_CaptureCallback(TIM_HandleTypeDef *htim)
{
    uint32_t captured_value;

    if (htim->Instance == TIM1)
    {
        if (htim->Channel == HAL_TIM_ACTIVE_CHANNEL_1)
        {
            /*
             * Leer el valor capturado en TIM1_CCR1,
             * ccr es el registro de captura o comparacion.
             */
            captured_value = HAL_TIM_ReadCapturedValue(htim, TIM_CHANNEL_1);

            /*
             * Estado 0:
             * se espera el flanco de subida de ECHO.
             */
            if (hcsr04_capture_state == 0U)
            {
                hcsr04_rising_edge = captured_value;
                hcsr04_capture_state = 1U;

                /*
                 * Una vez detectado el inicio del pulso,
                 * cambiamos la polaridad para capturar
                 * el flanco de bajada.
                 */
                __HAL_TIM_SET_CAPTUREPOLARITY(htim,
                                              TIM_CHANNEL_1,
                                              TIM_INPUTCHANNELPOLARITY_FALLING);
            }

            /*
             * Estado 1:
             * se espera el flanco de bajada de ECHO.
             */
            else if (hcsr04_capture_state == 1U)
            {
                hcsr04_falling_edge = captured_value;

                /*
                 * Calcular ancho del pulso ECHO.
                 *
                 * Caso normal:
                 * falling_edge >= rising_edge
                 *
                 * Caso con desborde:
                 * falling_edge < rising_edge
                 */
                if (hcsr04_falling_edge >= hcsr04_rising_edge)
                {
                    hcsr04_pulse_us = hcsr04_falling_edge - hcsr04_rising_edge;
                }
                else
                {
                    hcsr04_pulse_us = (TIM1_MAX_COUNT - hcsr04_rising_edge)
                                    + hcsr04_falling_edge
                                    + 1UL;
                }

                /*
                 * Marcar medición terminada.
                 */
                hcsr04_measurement_done = 1U;
                hcsr04_capture_state = 2U;

                /*
                 * Dejar el canal listo para la próxima medición:
                 * primero se capturará nuevamente flanco de subida.
                 */
                __HAL_TIM_SET_CAPTUREPOLARITY(htim,
                                              TIM_CHANNEL_1,
                                              TIM_INPUTCHANNELPOLARITY_RISING);
            }
        }
    }
}

/* En esta funcion envia los valores si son validos, el valor del pulso y distancia 0 */
static void USART2_SendDistance(uint8_t valid, uint32_t pulse_us, uint32_t distance_x10_cm)
{
    char tx_buffer[128];
    int len;

    if (valid != 0U)
    {
        len = snprintf(tx_buffer,
                       sizeof(tx_buffer),
                       "Echo=%5lu us | Distancia=%lu.%lu cm\r\n",
                       (unsigned long)pulse_us,
                       (unsigned long)(distance_x10_cm / 10UL),
                       (unsigned long)(distance_x10_cm % 10UL));
    }
    else
    {
        len = snprintf(tx_buffer,
                       sizeof(tx_buffer),
                       "Error: sin eco o fuera de rango\r\n");
    }

    if (len > 0)
    {
        HAL_UART_Transmit(&huart2,
                          (uint8_t *)tx_buffer,
                          (uint16_t)len,
                          HAL_MAX_DELAY);
    }
}



/*control motor*/

/* luego defino el valor del adc y la configuracion del pwm,
 * la cantidad de periodos que voy a contar (4095),
 * el periodo del contabilizador que va a ser de 0 a 999
 * y la cantidad de muestras del promedio que voy a hacer (16),
 * ademas tambien defino los pines donde voy a ubicar el modulo para control de motor  */

#define ADC_MAX_VALUE          4095UL
#define PWM_PERIOD_COUNTS      1000UL   /* ARR + 1 */
#define ADC_FILTER_SIZE        16U      /* Cantidad de muestras del promedio móvil */
/* in1 en 1 / in2 en 0 o viceversa para darle sentido al motor */
/* Uso el pin cinco */
#define L298N_IN1_PIN          5U       /* PB5  - D4 */
/* Uso el pin 10  */
#define L298N_IN2_PIN          10U      /* PB10 - D6 */


void SystemClock_Config(void);
static void MX_GPIO_Init(void);
static void MX_USART2_UART_Init(void);
static void MX_TIM1_Init(void);
TIM_HandleTypeDef htim1;

UART_HandleTypeDef huart2;


/* defino dirección de motor, pines, variables para definir el adc, como voy a definir el duty del pwm */
static const char *motor_direction_text = "STOP";/* lo uso para mostrar por la terminal si el motor esta detenido */
/* USER CODE BEGIN PFP */
static void ADC1_PA4_Init_ByRegisters(void);
static uint32_t ADC1_ReadRaw(void);
static uint32_t ADC1_ReadMovingAverage(void);/* Promedio movil */

static void TIM2_CH1_PA5_PWM_Init_ByRegisters(void);
/*en la siguiente funcion el valor del adc crudo lo comparamos en el registro ccr del canal
 * pero con el adc promediado*/
static void PWM_SetDutyFromADC(uint32_t adc_raw);

static void L298N_DirectionPins_Init_ByRegisters(void);/* inicio pines de direccion */
static void L298N_MotorForward(void);/* gira adelante */
static void L298N_MotorReverse(void);/* gira atras */
static void L298N_MotorStop(void);/* freno motor */

static void USART2_SendADC_PWM_Values(uint32_t adc_value);

/*Funciones del motor*/
static void ADC1_PA4_Init_ByRegisters(void)
{
    RCC->AHB1ENR |= RCC_AHB1ENR_GPIOAEN;
    (void)RCC->AHB1ENR;

    GPIOA->MODER |= (3UL << (4U * 2U));
    GPIOA->PUPDR &= ~(3UL << (4U * 2U));

    RCC->APB2ENR |= RCC_APB2ENR_ADC1EN;
    (void)RCC->APB2ENR;

    /*
     * PCLK2 = 84 MHz
     * ADC clock = PCLK2 / 4 = 21 MHz
     */
    ADC->CCR &= ~(3UL << 16U);
    ADC->CCR |=  (1UL << 16U);

    /*
     * CR1 = 0:
     * - Resolución 12 bits
     * - Scan mode deshabilitado
     *
     * CR2 = 0:
     * - Conversión continua deshabilitada
     * - Alineación a la derecha
     * - Disparo por software
     */
    ADC1->CR1 = 0U;
    ADC1->CR2 = 0U;

    /*
     * Tiempo de muestreo del canal 4:
     * SMP4 = 100 -> 84 ciclos de ADC.
     */
    ADC1->SMPR2 &= ~(7UL << (4U * 3U));
    ADC1->SMPR2 |=  (4UL << (4U * 3U));

    /*
     * Secuencia regular de una sola conversión.
     */
    ADC1->SQR1 &= ~(0xFUL << 20U);

    /*
     * Primera conversión: canal 4.
     */
    ADC1->SQR3 &= ~(0x1FUL << 0U);
    ADC1->SQR3 |=  (4UL << 0U);

    ADC1->CR2 &= ~ADC_CR2_ALIGN;
    ADC1->CR2 &= ~ADC_CR2_CONT;
    ADC1->CR2 &= ~ADC_CR2_EXTEN;

    ADC1->CR2 |= ADC_CR2_ADON;

    HAL_Delay(1);
}

/* Lee el adc, el static lo que hace es definir que la funcion solo se define dentro de este archivo,
 * no se puede acceder desde otro modulo
 * uint32 es de retorno
 * */
static uint32_t ADC1_ReadRaw(void)
{
    ADC1->SR &= ~ADC_SR_EOC;

    ADC1->CR2 |= ADC_CR2_SWSTART;

    while ((ADC1->SR & ADC_SR_EOC) == 0U)
    {
        /* Polling */
    }

    return (ADC1->DR & 0xFFFFUL);
}

/* La siguiente funcion hace un filtro promedio movil
 * Estabiliza la lectura del adc, le saca el ruido que puede generarse
 * Mejor la estabilidad del flanco de bajada del pwm*/
static uint32_t ADC1_ReadMovingAverage(void)
{/* estos static hacen que se conserve el contenido cada vez que se llama a la funcion */
    static uint32_t buffer[ADC_FILTER_SIZE] = {0U};/* Vector que almacena elementos, que almacena 16 elementos */
    static uint32_t index = 0U;/* Declara el indice actual del buffer (en que posicion se guarda el proximo valor) */
    static uint32_t sum = 0U;
    static uint32_t count = 0U;/* Indica cuantas muestras validas hay en el buffer */

    uint32_t new_sample;
    uint32_t average;

    new_sample = ADC1_ReadRaw();/* Toma una muestra cruda del adc */

    if (count < ADC_FILTER_SIZE)/* Este if se ejecuta si el buffer no esta lleno */
    {
        buffer[index] = new_sample;
        sum += new_sample;
        count++;
    }
    else/* Cuando el buffer esta lleno, se resta la muestra mas antigua, se suma la nueva muestra */
    {
        sum -= buffer[index];
        buffer[index] = new_sample;
        sum += new_sample;
    }

    index++;/* Avanza el indice del buffer */

    if (index >= ADC_FILTER_SIZE)
    {
        index = 0U;
    }

    average = sum / count;/* una vez que tiene la suma hace el promedio */

    return average;
}
/* -------------------------------------------------------------
 * PWM en PA5 / D13 / TIM2_CH1
 * -------------------------------------------------------------
 * PA5 está conectado a D13 y al LED LD2.
 * PA5 puede funcionar como TIM2_CH1 usando AF1.
 */
static void TIM2_CH1_PA5_PWM_Init_ByRegisters(void)
{
    RCC->AHB1ENR |= RCC_AHB1ENR_GPIOAEN;
    (void)RCC->AHB1ENR;

    /*
     * PA5 como función alternativa.
     */
    GPIOA->MODER &= ~(3UL << (5U * 2U));
    GPIOA->MODER |=  (2UL << (5U * 2U));

    GPIOA->OTYPER &= ~(1UL << 5U);

    GPIOA->OSPEEDR &= ~(3UL << (5U * 2U));
    GPIOA->OSPEEDR |=  (2UL << (5U * 2U));

    GPIOA->PUPDR &= ~(3UL << (5U * 2U));

    /*
     * AF1 en PA5 corresponde a TIM2_CH1.
     */
    GPIOA->AFR[0] &= ~(0xFUL << (5U * 4U));
    GPIOA->AFR[0] |=  (1UL   << (5U * 4U));

    RCC->APB1ENR |= RCC_APB1ENR_TIM2EN;
    (void)RCC->APB1ENR;

    TIM2->CR1 &= ~TIM_CR1_CEN;

    /*
     * f_TIM2 = 84 MHz
     * PSC = 83  -> f_CNT = 1 MHz
     * ARR = 999 -> f_PWM = 1 kHz
     */
    TIM2->PSC = 83U;
    TIM2->ARR = 999U;
    TIM2->CNT = 0U;

    TIM2->CCR1 = 0U;

    /*
     * Canal 1 como salida.
     */
    TIM2->CCMR1 &= ~TIM_CCMR1_CC1S;

    /*
     * PWM mode 1:
     * salida activa mientras CNT < CCR1.
     */
    TIM2->CCMR1 &= ~TIM_CCMR1_OC1M;
    TIM2->CCMR1 |=  (6UL << 4U);

    /*
     * Preload de CCR1.
     */
    TIM2->CCMR1 |= TIM_CCMR1_OC1PE;

    /*
     * Polaridad activa en alto y salida CH1 habilitada.
     */
    TIM2->CCER &= ~TIM_CCER_CC1P;
    TIM2->CCER |=  TIM_CCER_CC1E;

    /*
     * Preload de ARR.
     */
    TIM2->CR1 |= TIM_CR1_ARPE;

    /*
     * Conteo ascendente, edge-aligned.
     */
    TIM2->CR1 &= ~TIM_CR1_CMS;
    TIM2->CR1 &= ~TIM_CR1_DIR;

    /*
     * Cargar PSC, ARR y CCR.
     */
    TIM2->EGR |= TIM_EGR_UG;

    /*
     * Arrancar TIM2.
     */
    TIM2->CR1 |= TIM_CR1_CEN;
}


static void PWM_SetDutyFromADC(uint32_t adc_raw)/* En esta variable escala el valor del adc al valor y lo anota en ccr1 */
{
    uint32_t ccr_value;

    if (adc_raw > ADC_MAX_VALUE)
    {
        adc_raw = ADC_MAX_VALUE;
    }

    /*
     * ADC: 0 a 4095
     * PWM: 0 a 1000 cuentas
     */
    ccr_value = (adc_raw * PWM_PERIOD_COUNTS) / ADC_MAX_VALUE;

    TIM2->CCR1 = ccr_value;
}


/* -------------------------------------------------------------
 * Control de dirección para motor DC con L298N
 * -------------------------------------------------------------
 * ENA recibe la PWM desde PA5 / D13 / TIM2_CH1.
 *
 * IN1 IN3 -> PB5  / D4
 * IN2 IN4 -> PB10 / D6
 */
static void L298N_DirectionPins_Init_ByRegisters(void)
{
    RCC->AHB1ENR |= RCC_AHB1ENR_GPIOBEN;/* INICIA LOS PINES, ES OBLIGATORIO ANTES DE CONFIGURARLOS */
    (void)RCC->AHB1ENR;/* Fuerza lectura de registro, por precaucion */

    /*
     * PB5 y PB10 como salidas digitales.
     */
    GPIOB->MODER &= ~((3UL << (L298N_IN1_PIN * 2U)) |
                      (3UL << (L298N_IN2_PIN * 2U)));/* define modo de cada pin, borra cualquier configuracion previa */

    GPIOB->MODER |=  ((1UL << (L298N_IN1_PIN * 2U)) |
                      (1UL << (L298N_IN2_PIN * 2U)));/* Escribimos*/

    /*
     * Push-pull., configuramos la salida para forzar nivel alto o bajo
     */
    GPIOB->OTYPER &= ~((1UL << L298N_IN1_PIN) |
                       (1UL << L298N_IN2_PIN));

    /*
     * Velocidad baja.
     */
    GPIOB->OSPEEDR &= ~((3UL << (L298N_IN1_PIN * 2U)) |
                        (3UL << (L298N_IN2_PIN * 2U)));

    /*
     * Sin pull-up ni pull-down.
     */
    GPIOB->PUPDR &= ~((3UL << (L298N_IN1_PIN * 2U)) |
                      (3UL << (L298N_IN2_PIN * 2U)));

    L298N_MotorStop();
}


static void L298N_MotorForward(void)
{
    /*
     * IN1 = 1
     * IN2 = 0
     */
    GPIOB->BSRR = (1UL << L298N_IN2_PIN) |
                  (1UL << (L298N_IN1_PIN + 16U));/* aca configuro los pines en 1 y en cero */

    motor_direction_text = "FORWARD";
}


static void L298N_MotorReverse(void)
{
    /*
     * IN1 = 0
     * IN2 = 1
     */
    GPIOB->BSRR = (1UL << (L298N_IN2_PIN + 16U)) |
                  (1UL << L298N_IN1_PIN);/* Aca viceversa */

    motor_direction_text = "REVERSE";
}


static void L298N_MotorStop(void)
{
    /*
     * IN1 = 0
     * IN2 = 0
     */
    GPIOB->BSRR = (1UL << (L298N_IN1_PIN + 16U)) |
                  (1UL << (L298N_IN2_PIN + 16U));

    motor_direction_text = "STOP";
}


/* -------------------------------------------------------------
 * Envío por USART2
 * ------------------------------------------------------------- */
static void USART2_SendADC_PWM_Values(uint32_t adc_value)
{
    char tx_buffer[160];/* esta en 160 porque tambien va la direccion del motor y los otros datos */

    uint32_t voltage_mv;
    uint32_t ccr_value;
    uint32_t duty_x10;
    int len;

    if (adc_value > ADC_MAX_VALUE)
    {
        adc_value = ADC_MAX_VALUE;
    }

    voltage_mv = (adc_value * 3300UL) / ADC_MAX_VALUE;

    ccr_value = (adc_value * PWM_PERIOD_COUNTS) / ADC_MAX_VALUE;

    duty_x10 = (ccr_value * 1000UL) / PWM_PERIOD_COUNTS;

    len = snprintf(tx_buffer,
                   sizeof(tx_buffer),
                   "ADC_filtrado=%4lu | V=%lu.%03lu V | CCR1=%4lu | Duty=%lu.%lu %% | Motor=%s\r\n",
                   (unsigned long)adc_value,
                   (unsigned long)(voltage_mv / 1000UL),
                   (unsigned long)(voltage_mv % 1000UL),
                   (unsigned long)ccr_value,
                   (unsigned long)(duty_x10 / 10UL),
                   (unsigned long)(duty_x10 % 10UL),
                   motor_direction_text);

    if (len > 0)
    {
        HAL_UART_Transmit(&huart2,
                          (uint8_t *)tx_buffer,
                          (uint16_t)len,
                          HAL_MAX_DELAY);
    }
}
int main(void)
{/* PRIMERO INICIALIZAO LA HAL, EL RELOJ EL GPIO Y EL USART 2 QUE COMPARTES AMBOS MODULOS*/
	HAL_Init();
	SystemClock_Config();
	MX_GPIO_Init();
	MX_USART2_UART_Init();
	MX_TIM1_Init();

    /*Main del ULTRASONIDO*/
	HAL_TIM_IC_Start_IT(&htim1, TIM_CHANNEL_1);/** Iniciar TIM1 Channel 1 en modo Input Capture con interrupción.* ECHO está conectado a D7 / PA8 / TIM1_CH1.
	   */
	HAL_GPIO_WritePin(HCSR04_TRIG_PORT, HCSR04_TRIG_PIN, GPIO_PIN_RESET);/*
	   * Asegurar TRIG en bajo al inicio.
	   * TRIG está conectado a D8 / PA9.
	   */

	/* MAIN DE MOTOR*/
	ADC1_PA4_Init_ByRegisters();
	TIM2_CH1_PA5_PWM_Init_ByRegisters();
	L298N_DirectionPins_Init_ByRegisters();

	  /*
	   * Sentido inicial del motor.
	   * La velocidad queda controlada por la PWM en ENA.
	   */
	  //L298N_MotorForward();
	L298N_MotorForward();


	while (1)
	{
	    uint32_t Ahora = HAL_GetTick();
	    /* ── aca defino un valor del tick a usar, que voya
	     * llamar Ahora como tiempo actual ── */

	    /* ── Tarea 1: ADC + PWM motor (cada 10 ms) ── */
	    static uint32_t last_motor_tick = 0U;
	    if ((Ahora - last_motor_tick) >= 10U)
	    {
	        last_motor_tick = Ahora;

	        uint32_t adc_filtered = ADC1_ReadMovingAverage();
	        PWM_SetDutyFromADC(adc_filtered);

	        /* ── Subtarea: UART motor (cada 1000ms  para que coincida con el sensor ) ── */
	        static uint32_t last_uart_motor_tick = 0U;
	        if ((Ahora - last_uart_motor_tick) >= 1000U)
	        {
	            last_uart_motor_tick = Ahora;
	            USART2_SendADC_PWM_Values(adc_filtered);
	        }
	    }

	    /* ── Tarea 2: HC-SR04 (cada 1000 ms) ── */
	    static uint32_t last_hcsr04_tick = 0U;
	    if ((Ahora - last_hcsr04_tick) >= HCSR04_MEASUREMENT_PERIOD_MS)
	    {
	        last_hcsr04_tick = Ahora;

	        uint32_t pulse_us = 0U;
	        uint32_t distance_x10_cm = 0U;
	        uint8_t valid = HCSR04_ReadDistance_IC(&pulse_us, &distance_x10_cm);

	        USART2_SendDistance(valid, pulse_us, distance_x10_cm);
	    }
	}
}











void SystemClock_Config(void)
{
  RCC_OscInitTypeDef RCC_OscInitStruct = {0};
  RCC_ClkInitTypeDef RCC_ClkInitStruct = {0};

  /** Configure the main internal regulator output voltage
  */
  __HAL_RCC_PWR_CLK_ENABLE();
  __HAL_PWR_VOLTAGESCALING_CONFIG(PWR_REGULATOR_VOLTAGE_SCALE3);

  /** Initializes the RCC Oscillators according to the specified parameters
  * in the RCC_OscInitTypeDef structure.
  */
  RCC_OscInitStruct.OscillatorType = RCC_OSCILLATORTYPE_HSI;
  RCC_OscInitStruct.HSIState = RCC_HSI_ON;
  RCC_OscInitStruct.HSICalibrationValue = RCC_HSICALIBRATION_DEFAULT;
  RCC_OscInitStruct.PLL.PLLState = RCC_PLL_ON;
  RCC_OscInitStruct.PLL.PLLSource = RCC_PLLSOURCE_HSI;
  RCC_OscInitStruct.PLL.PLLM = 16;
  RCC_OscInitStruct.PLL.PLLN = 336;
  RCC_OscInitStruct.PLL.PLLP = RCC_PLLP_DIV4;
  RCC_OscInitStruct.PLL.PLLQ = 2;
  RCC_OscInitStruct.PLL.PLLR = 2;
  if (HAL_RCC_OscConfig(&RCC_OscInitStruct) != HAL_OK)
  {
    Error_Handler();
  }

  /** Initializes the CPU, AHB and APB buses clocks
  */
  RCC_ClkInitStruct.ClockType = RCC_CLOCKTYPE_HCLK|RCC_CLOCKTYPE_SYSCLK
                              |RCC_CLOCKTYPE_PCLK1|RCC_CLOCKTYPE_PCLK2;
  RCC_ClkInitStruct.SYSCLKSource = RCC_SYSCLKSOURCE_PLLCLK;
  RCC_ClkInitStruct.AHBCLKDivider = RCC_SYSCLK_DIV1;
  RCC_ClkInitStruct.APB1CLKDivider = RCC_HCLK_DIV2;
  RCC_ClkInitStruct.APB2CLKDivider = RCC_HCLK_DIV1;

  if (HAL_RCC_ClockConfig(&RCC_ClkInitStruct, FLASH_LATENCY_2) != HAL_OK)
  {
    Error_Handler();
  }
}

/**
  * @brief USART2 Initialization Function
  * @param None
  * @retval None
  */
static void MX_USART2_UART_Init(void)
{

  /* USER CODE BEGIN USART2_Init 0 */

  /* USER CODE END USART2_Init 0 */

  /* USER CODE BEGIN USART2_Init 1 */

  /* USER CODE END USART2_Init 1 */
  huart2.Instance = USART2;
  huart2.Init.BaudRate = 115200;
  huart2.Init.WordLength = UART_WORDLENGTH_8B;
  huart2.Init.StopBits = UART_STOPBITS_1;
  huart2.Init.Parity = UART_PARITY_NONE;
  huart2.Init.Mode = UART_MODE_TX_RX;
  huart2.Init.HwFlowCtl = UART_HWCONTROL_NONE;
  huart2.Init.OverSampling = UART_OVERSAMPLING_16;
  if (HAL_UART_Init(&huart2) != HAL_OK)
  {
    Error_Handler();
  }
  /* USER CODE BEGIN USART2_Init 2 */

  /* USER CODE END USART2_Init 2 */

}

/**
  * @brief TIM1 Initialization Function
  * @note  Input Capture CH1 en PA8 (D7) para ECHO del HC-SR04.
  *        1 cuenta = 1 us con TIM1CLK = 84 MHz, PSC = 83.
  */
static void MX_TIM1_Init(void)
{
  TIM_IC_InitTypeDef sConfigIC = {0};

  htim1.Instance = TIM1;
  htim1.Init.Prescaler = 83;
  htim1.Init.CounterMode = TIM_COUNTERMODE_UP;
  htim1.Init.Period = 65535;
  htim1.Init.ClockDivision = TIM_CLOCKDIVISION_DIV1;
  htim1.Init.RepetitionCounter = 0;
  htim1.Init.AutoReloadPreload = TIM_AUTORELOAD_PRELOAD_DISABLE;
  if (HAL_TIM_IC_Init(&htim1) != HAL_OK)
  {
    Error_Handler();
  }

  sConfigIC.ICPolarity = TIM_INPUTCHANNELPOLARITY_RISING;
  sConfigIC.ICSelection = TIM_ICSELECTION_DIRECTTI;
  sConfigIC.ICPrescaler = TIM_ICPSC_DIV1;
  sConfigIC.ICFilter = 0;
  if (HAL_TIM_IC_ConfigChannel(&htim1, &sConfigIC, TIM_CHANNEL_1) != HAL_OK)
  {
    Error_Handler();
  }
}

/**
  * @brief GPIO Initialization Function
  * @param None
  * @retval None
  */
static void MX_GPIO_Init(void)
{
  GPIO_InitTypeDef GPIO_InitStruct = {0};
/* USER CODE BEGIN MX_GPIO_Init_1 */
/* USER CODE END MX_GPIO_Init_1 */

  /* GPIO Ports Clock Enable */
  __HAL_RCC_GPIOC_CLK_ENABLE();
  __HAL_RCC_GPIOH_CLK_ENABLE();
  __HAL_RCC_GPIOA_CLK_ENABLE();
  __HAL_RCC_GPIOB_CLK_ENABLE();

  /*Configure GPIO pin Output Level */
  HAL_GPIO_WritePin(LD2_GPIO_Port, LD2_Pin, GPIO_PIN_RESET);

  /*Configure GPIO pin : B1_Pin */
  GPIO_InitStruct.Pin = B1_Pin;
  GPIO_InitStruct.Mode = GPIO_MODE_IT_FALLING;
  GPIO_InitStruct.Pull = GPIO_NOPULL;
  HAL_GPIO_Init(B1_GPIO_Port, &GPIO_InitStruct);

  /*Configure GPIO pin : LD2_Pin */
  GPIO_InitStruct.Pin = LD2_Pin;
  GPIO_InitStruct.Mode = GPIO_MODE_OUTPUT_PP;
  GPIO_InitStruct.Pull = GPIO_NOPULL;
  GPIO_InitStruct.Speed = GPIO_SPEED_FREQ_LOW;
  HAL_GPIO_Init(LD2_GPIO_Port, &GPIO_InitStruct);

/* USER CODE BEGIN MX_GPIO_Init_2 */
  GPIO_InitStruct.Pin = GPIO_PIN_9;
  GPIO_InitStruct.Mode = GPIO_MODE_OUTPUT_PP;
  GPIO_InitStruct.Pull = GPIO_NOPULL;
  GPIO_InitStruct.Speed = GPIO_SPEED_FREQ_HIGH;
  HAL_GPIO_Init(GPIOA, &GPIO_InitStruct);
  HAL_GPIO_WritePin(GPIOA, GPIO_PIN_9, GPIO_PIN_RESET);
/* USER CODE END MX_GPIO_Init_2 */
}

/* USER CODE BEGIN 4 */

/* USER CODE END 4 */

/**
  * @brief  This function is executed in case of error occurrence.
  * @retval None
  */
void Error_Handler(void)
{
  /* USER CODE BEGIN Error_Handler_Debug */
  /* User can add his own implementation to report the HAL error return state */
  __disable_irq();
  while (1)
  {
  }
  /* USER CODE END Error_Handler_Debug */
}

#ifdef  USE_FULL_ASSERT
/**
  * @brief  Reports the name of the source file and the source line number
  *         where the assert_param error has occurred.
  * @param  file: pointer to the source file name
  * @param  line: assert_param error line source number
  * @retval None
  */
void assert_failed(uint8_t *file, uint32_t line)
{
  /* USER CODE BEGIN 6 */
  /* User can add his own implementation to report the file name and line number,
     ex: printf("Wrong parameters value: file %s on line %d\r\n", file, line) */
  /* USER CODE END 6 */
}
#endif /* USE_FULL_ASSERT */
